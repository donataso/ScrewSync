## west.yml
```yaml
manifest:
  remotes:
    - name: zephyrproject-rtos
      url-base: https://github.com/zephyrproject-rtos

  projects:
    - name: zephyr
      remote: zephyrproject-rtos
      revision: v4.5.0
      import:
        name-allowlist:
          - hal_espressif
          - hal_xtensa
          - littlefs
          - mbedtls
          - mcuboot
          - tf-psa-crypto
```
