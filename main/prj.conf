## CMakeLists.txt
```
cmake_minimum_required(VERSION 3.20.0)
find_package(Zephyr REQUIRED HINTS $ENV{ZEPHYR_BASE})
project(screwsync)

target_sources(app PRIVATE
    src/main.cpp
    lib/Console/Console.cpp
    lib/Command/Command.cpp
    lib/Command/CommandWifi.cpp
    lib/Command/CommandSystem.cpp
    lib/Command/CommandMotion.cpp
    lib/Command/CommandMode.cpp
    lib/Motion/Motion.cpp
    lib/Status/Status.cpp
    lib/Wifi/Wifi.cpp
    lib/Wifi/WifiSaved.cpp
    lib/Wifi/WifiScan.cpp
    lib/Wifi/WifiWatchdog.cpp
    lib/WifiPortal/WifiPortal.cpp
    lib/StaticAssets/StaticAssets.cpp
    lib/PersistBlob/PersistBlob.cpp
    lib/Settings/Settings.cpp
    lib/Settings/SettingsFields.cpp
    lib/RunSettings/RunSettings.cpp
    lib/Machine/Machine.cpp
    lib/Watchdog/Watchdog.cpp
    lib/Mode/Mode.cpp
    lib/Mode/ModeParams.cpp
    lib/Mode/ModeParamCodec.cpp
    lib/Mode/ModeMath.cpp
    lib/Mode/ModeMotion.cpp
    lib/Mode/ModeGear.cpp
    lib/Mode/ModeAsync.cpp
    lib/Mode/ModePass.cpp
    lib/Mode/ModePassPlan.cpp
    lib/Mode/ModeTurn.cpp
    lib/Mode/ModeThread.cpp
    lib/Mode/ModePart.cpp
    lib/Mode/ModeSlot.cpp
    lib/Mode/ModeEllipse.cpp
    lib/Mode/ModeGcode.cpp
    lib/Mode/ModeProbe.cpp
    lib/Mode/ProbeCycle.cpp
    lib/Probe/ProbeInput.cpp
    lib/Pins/Pins.cpp
    lib/Pins/PinMap.cpp
    lib/Pins/PinMapJson.cpp
    lib/Thread/ThreadTable.cpp
    lib/Thread/ThreadStore.cpp
    lib/Thread/ThreadStoreJson.cpp
    lib/Thread/ThreadTableJson.cpp
    lib/Backup/Backup.cpp
    lib/Backup/JsonSpan.cpp
    lib/Encoder/Encoder.cpp
    lib/Encoder/EncoderFilter.cpp
    lib/Handwheel/Handwheel.cpp
    lib/Stepper/Stepper.cpp
    lib/Stepper/StepperRamp.cpp
    lib/Stepper/StepperLimits.cpp
    lib/Sync/Sync.cpp
    lib/Sync/SyncRatio.cpp
    lib/Jog/Jog.cpp
    lib/Jog/JogRatio.cpp
    lib/Jog/JogStep.cpp
    lib/Jog/JogStepDial.cpp
    lib/Switches/Switches.cpp
    lib/Rpm/Rpm.cpp
    lib/Rpm/RpmCalc.cpp
    lib/Gcode/GcodeCore.cpp
    lib/Gcode/GcodeLathecode.cpp
    lib/Gcode/GcodeFlavors.cpp
    lib/GcodeStore/GcodeMeta.cpp
    lib/GcodeStore/GcodeFiles.cpp
    lib/GcodeStore/GcodeStore.cpp
    lib/WebUi/WebUi.cpp
    lib/WebUi/WebHttp.cpp
    lib/WebUi/WebText.cpp
    lib/WebUi/WebUpdate.cpp
    lib/WebUi/WebDocs.cpp
    lib/WebUi/WebGcode.cpp
    lib/WebUi/WsCommand.cpp
    lib/WebUi/WsMessages.cpp
    lib/Ota/Ota.cpp
    lib/LogRing/LogRing.cpp
    lib/Events/Events.cpp
    lib/Outputs/Outputs.cpp
)

target_include_directories(app PRIVATE
    src
    lib/Command
    lib/Motion
    lib/Status
    lib/Console
    lib/PersistBlob
    lib/Settings
    lib/RunSettings
    lib/Machine
    lib/Watchdog
    lib/Mode
    lib/Probe
    lib/Pins
    include
    lib/Thread
    lib/Backup
    lib/Encoder
    lib/Handwheel
    lib/Stepper
    lib/Sync
    lib/Jog
    lib/Switches
    lib/Rpm
    lib/Gcode
    lib/GcodeStore
    lib/StaticAssets
    lib/WebUi
    lib/Ota
    lib/Wifi
    lib/WifiPortal
    lib/LogRing
    lib/Events
    lib/Outputs
    ${CMAKE_BINARY_DIR}/include
    # WsCommand reads a client's peer address from Zephyr's internal websocket context.
    ${ZEPHYR_BASE}/subsys/net/lib/websocket
)

zephyr_get(SCREWSYNC_TARGET SYSBUILD LOCAL)
if(NOT SCREWSYNC_TARGET)
    message(FATAL_ERROR "SCREWSYNC_TARGET is not set -- build through the Makefile")
endif()
target_compile_definitions(app PRIVATE SCREWSYNC_TARGET="${SCREWSYNC_TARGET}")
zephyr_get(SCREWSYNC_DISPLAY SYSBUILD LOCAL)
if(NOT SCREWSYNC_DISPLAY)
    message(FATAL_ERROR "SCREWSYNC_DISPLAY is not set -- build through the Makefile (TARGET=...)")
endif()
set(SCREWSYNC_MAIN_DIR ${CMAKE_CURRENT_LIST_DIR})
include(${CMAKE_CURRENT_LIST_DIR}/../displays/${SCREWSYNC_DISPLAY}/display.cmake)

target_compile_options(app PRIVATE -Werror)

zephyr_linker_sources(SECTIONS sections-rom.ld)

execute_process(
    COMMAND git describe --always --dirty
    WORKING_DIRECTORY ${CMAKE_CURRENT_LIST_DIR}
    OUTPUT_VARIABLE FW_VERSION
    OUTPUT_STRIP_TRAILING_WHITESPACE
    RESULT_VARIABLE GIT_DESCRIBE_RESULT
)
if(NOT GIT_DESCRIBE_RESULT EQUAL 0)
    set(FW_VERSION "dev")
endif()
target_compile_definitions(app PRIVATE FW_VERSION="${FW_VERSION}")

set(WEB_BUNDLE ${CMAKE_CURRENT_LIST_DIR}/../.build/firmware-client/index.html)
if(NOT EXISTS ${WEB_BUNDLE})
    message(FATAL_ERROR "${WEB_BUNDLE} is missing -- run `make web-build` first (builds it in Docker, no Node on host)")
endif()
generate_inc_file_for_target(app ${WEB_BUNDLE} ${CMAKE_BINARY_DIR}/include/web_index_html_gz.inc --gzip)
```

## Kconfig
```
mainmenu "ScrewSync"

source "Kconfig.zephyr"

config SCREWSYNC_DISPLAY_IMAGE
	bool "Store and flash a display firmware image"
```

## prj.conf
```kconfig
CONFIG_CPP=y
CONFIG_STD_CPP17=y
CONFIG_REQUIRES_FULL_LIBCPP=y

CONFIG_GPIO=y
CONFIG_REBOOT=y
CONFIG_WATCHDOG=y
CONFIG_TASK_WDT=y
CONFIG_TASK_WDT_MIN_TIMEOUT=500
CONFIG_TASK_WDT_HW_FALLBACK_DELAY=100
CONFIG_HWINFO=y

CONFIG_COUNTER=y

CONFIG_SENSOR=y
CONFIG_PCNT_ESP32_TRIGGER=n

CONFIG_FLASH=y
CONFIG_FLASH_MAP=y
CONFIG_FLASH_PAGE_LAYOUT=y
CONFIG_NVS=y
CONFIG_SETTINGS=y
CONFIG_NVS_LOOKUP_CACHE=y
CONFIG_NVS_LOOKUP_CACHE_SIZE=512
CONFIG_SETTINGS_NVS_NAME_CACHE=y

# Gcode partition: LittleFS, mounted lazily by GcodeStore (never at boot).
CONFIG_FILE_SYSTEM=y
CONFIG_FILE_SYSTEM_LITTLEFS=y

CONFIG_LOG=y
CONFIG_LOG_MODE_IMMEDIATE=y
CONFIG_STACK_SENTINEL=y

CONFIG_NETWORKING=y
CONFIG_NET_IPV4=y
CONFIG_NET_IPV6=n
CONFIG_NET_TCP=y
CONFIG_NET_DHCPV4=y
CONFIG_NET_SOCKETS=y
CONFIG_NET_MAX_CONTEXTS=12
CONFIG_NET_MAX_CONN=8
CONFIG_NET_PKT_RX_COUNT=8
CONFIG_NET_PKT_TX_COUNT=8
CONFIG_NET_BUF_DATA_SIZE=256
CONFIG_HTTP_SERVER_CLIENT_BUFFER_SIZE=4096
CONFIG_ZVFS_POLL_MAX=16

CONFIG_NET_MGMT_EVENT_QUEUE_TIMEOUT=5000
CONFIG_NET_MGMT_EVENT_QUEUE_SIZE=16
CONFIG_MAIN_STACK_SIZE=5200
CONFIG_NET_TX_STACK_SIZE=4096
CONFIG_NET_RX_STACK_SIZE=4096
CONFIG_SYSTEM_WORKQUEUE_STACK_SIZE=4096
CONFIG_NET_SOCKETS_SERVICE_STACK_SIZE=4096

CONFIG_WIFI=y
CONFIG_WIFI_STA_AUTO_DHCPV4=n
CONFIG_NET_DHCPV4_SERVER=y
CONFIG_NET_DHCPV4_SERVER_ICMP_PROBE_TIMEOUT=0
CONFIG_WIFI_CREDENTIALS=y
CONFIG_WIFI_CREDENTIALS_MAX_ENTRIES=5

CONFIG_NET_HOSTNAME_ENABLE=y
CONFIG_MDNS_RESPONDER=y
CONFIG_MDNS_RESPONDER_DNS_SD=y
CONFIG_DNS_SD=y

CONFIG_ESP_WIFI_HEAP_SPIRAM=y
CONFIG_ESP32_WIFI_NET_ALLOC_SPIRAM=y

CONFIG_HTTP_SERVER=y
CONFIG_HTTP_SERVER_MAX_CLIENTS=2
CONFIG_HTTP_SERVER_WEBSOCKET=y
CONFIG_WEBSOCKET_MAX_CONTEXTS=4
CONFIG_HTTP_SERVER_CAPTURE_HEADERS=y

CONFIG_JSON_LIBRARY=y

CONFIG_ZBUS=y
CONFIG_JSON_LIBRARY_FP_SUPPORT=y
CONFIG_CBPRINTF_FP_SUPPORT=y

CONFIG_IMG_MANAGER=y
CONFIG_STREAM_FLASH=y
CONFIG_IMG_BLOCK_BUF_SIZE=4096

# Float math runs in several threads; save FPU registers on switch.
CONFIG_FPU=y
CONFIG_FPU_SHARING=y
```

## app.overlay
```dts
/* Z/X stepper step pulses, each from its own General Purpose Timer (TIMG1
 * T0/T1 -- TIMG0 is reserved for the Wi-Fi stack's RTC slow-clock
 * calibration), prescaled to a 1MHz tick so 1 tick = 1us in Stepper.cpp's
 * ramp math. */
&timer2 {
	status = "okay";
	prescaler = <80>;

	counter {
		status = "okay";
	};
};

&timer3 {
	status = "okay";
	prescaler = <80>;

	counter {
		status = "okay";
	};
};
```

## dts/bindings/screwsync,connectors.yaml
```yaml
description: |
  Board connectors for the runtime pin map. Each child is one connector.
  The function properties give the default pins, in signal order. The pins
  of one function must be next to each other in one connector.

compatible: "screwsync,connectors"

properties:
  board-name:
    type: string
    required: true
  strapping-gpios:
    type: array
  reserved-gpios:
    type: array
  reserved-notes:
    type: string-array
    description: One note per reserved-gpios entry.
  z-motor:
    type: array
    description: ENA, DIR, STEP
  x-motor:
    type: array
    description: ENA, DIR, STEP
  spindle:
    type: array
    description: A, B
  z-handwheel:
    type: array
    description: A, B
  x-handwheel:
    type: array
    description: A, B
  probe:
    type: array
    description: SIG

child-binding:
  description: One connector.
  properties:
    title:
      type: string
      required: true
    row:
      type: int
      required: true
    col:
      type: int
      required: true
    pins:
      type: array
      required: true
      description: GPIO numbers, or PIN_5V / PIN_GND from dt-bindings/screwsync/pins.h.
```

## src/main.cpp
```c
#include <zephyr/kernel.h>
#include <zephyr/logging/log.h>
#include "Console.hpp"
#include "PersistBlob.hpp"
#include "Settings.hpp"
#include "Pins.hpp"
#include "Encoder.hpp"
#include "Handwheel.hpp"
#include "Stepper.hpp"
#include "RunSettings.hpp"
#include "Machine.hpp"
#include "Watchdog.hpp"
#include "Mode.hpp"
#include "ProbeInput.hpp"
#include "ThreadStore.hpp"
#include "Jog.hpp"
#include "Rpm.hpp"
#include "Wifi.hpp"
#include "WebUi.hpp"
#include "Display.hpp"
#include "Switches.hpp"
#include "Outputs.hpp"

LOG_MODULE_REGISTER(main, LOG_LEVEL_INF); // Wifi declares against this module

int main(void)
{
    PersistBlob::preload();
    Machine::begin();
    Settings::load();
    Pins::begin();
    Outputs::begin();
    Encoder::begin();
    Handwheel::begin();
    Stepper::begin();
    ProbeInput::begin(Mode::probeEdge);
    Watchdog::begin();
    RunSettings::load();
    ThreadStore::begin();
    Mode::begin();
    Jog::begin();
    Switches::begin();
    Rpm::begin();
    Display::begin();
    Wifi::begin();
    WebUi::begin();

    while (1) {
        consolePoll();
        Wifi::loop();
        WebUi::poll();
        k_sleep(K_MSEC(50));
    }
}
```

## src/config.hpp
```c
#ifndef config_h
#define config_h

#define DEVICE_NAME "ScrewSync"

#define X_AXIS_ENABLED 1
#define DRO_Z_ENABLED 0
#define DRO_X_ENABLED 0

#define DEFAULT_STATUS_PUSH_INTERVAL_MS 500

#define DEFAULT_JOG_STEP_DU 5000

#endif
```
