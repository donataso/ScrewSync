## CMakeLists.txt
```
cmake_minimum_required(VERSION 3.20.0)
find_package(Zephyr REQUIRED HINTS $ENV{ZEPHYR_BASE})
project(screwsync_unit_tests)

get_filename_component(FIRMWARE_DIR "${CMAKE_CURRENT_LIST_DIR}/../.." REALPATH)
get_filename_component(REPO_DIR "${FIRMWARE_DIR}/.." REALPATH)

target_sources(app PRIVATE
    src/test_stepper_ramp.cpp
    src/test_sync_ratio.cpp
    src/test_jog_ratio.cpp
    src/test_stepper_limits.cpp
    src/test_rpm_calc.cpp
    src/test_thread_table.cpp
    src/test_gcode.cpp
    src/test_gcode_meta.cpp
    src/test_probe_cycle.cpp
    src/test_mode_cells.cpp
    src/test_mode_pass_plan.cpp
    src/test_mode_param_codec.cpp
    src/test_mode_math.cpp
    src/test_encoder_filter.cpp
    src/test_display_text.cpp
    src/test_web_text.cpp
    src/test_nextion.cpp
    src/test_thread_table_json.cpp
    src/test_settings_fields.cpp
    src/test_json_span.cpp
    src/test_pin_map.cpp
    src/test_switch_debounce.cpp
    src/test_jog_step.cpp
    src/test_jog_button.cpp
    ${FIRMWARE_DIR}/lib/Stepper/StepperRamp.cpp
    ${FIRMWARE_DIR}/lib/Stepper/StepperLimits.cpp
    ${FIRMWARE_DIR}/lib/Rpm/RpmCalc.cpp
    ${FIRMWARE_DIR}/lib/Sync/SyncRatio.cpp
    ${FIRMWARE_DIR}/lib/Jog/JogRatio.cpp
    ${FIRMWARE_DIR}/lib/Jog/JogStep.cpp
    ${FIRMWARE_DIR}/lib/Thread/ThreadTable.cpp
    ${FIRMWARE_DIR}/lib/Gcode/GcodeCore.cpp
    ${FIRMWARE_DIR}/lib/Gcode/GcodeLathecode.cpp
    ${FIRMWARE_DIR}/lib/Gcode/GcodeFlavors.cpp
    ${FIRMWARE_DIR}/lib/GcodeStore/GcodeMeta.cpp
    ${FIRMWARE_DIR}/lib/Mode/ProbeCycle.cpp
    ${FIRMWARE_DIR}/lib/Display/ModeCells.cpp
    ${FIRMWARE_DIR}/lib/Display/DisplayText.cpp
    ${FIRMWARE_DIR}/lib/Mode/ModePassPlan.cpp
    ${FIRMWARE_DIR}/lib/Mode/ModeParamCodec.cpp
    ${FIRMWARE_DIR}/lib/Mode/ModeMath.cpp
    ${FIRMWARE_DIR}/lib/Encoder/EncoderFilter.cpp
    ${FIRMWARE_DIR}/lib/WebUi/WebText.cpp
    ${FIRMWARE_DIR}/lib/Nextion/NextionFrame.cpp
    ${FIRMWARE_DIR}/lib/Nextion/NextionAttrs.cpp
    ${FIRMWARE_DIR}/lib/Thread/ThreadTableJson.cpp
    ${FIRMWARE_DIR}/lib/Settings/SettingsFields.cpp
    ${FIRMWARE_DIR}/lib/Backup/JsonSpan.cpp
    ${FIRMWARE_DIR}/lib/Pins/PinMap.cpp
    ${FIRMWARE_DIR}/lib/Pins/PinMapJson.cpp
)

target_include_directories(app PRIVATE
    ${FIRMWARE_DIR}/lib/Pins
    ${FIRMWARE_DIR}/lib/Switches
    ${FIRMWARE_DIR}/lib/Stepper
    ${FIRMWARE_DIR}/lib/Sync
    ${FIRMWARE_DIR}/lib/Jog
    ${FIRMWARE_DIR}/lib/Rpm
    ${FIRMWARE_DIR}/lib/Thread
    ${FIRMWARE_DIR}/lib/Gcode
    ${FIRMWARE_DIR}/lib/GcodeStore
    ${FIRMWARE_DIR}/lib/Mode
    ${FIRMWARE_DIR}/lib/Probe
    ${FIRMWARE_DIR}/lib/Display
    ${FIRMWARE_DIR}/lib/Encoder
    ${FIRMWARE_DIR}/lib/WebUi
    ${FIRMWARE_DIR}/lib/Nextion
    ${FIRMWARE_DIR}/lib/Settings
    ${FIRMWARE_DIR}/lib/Backup
    ${FIRMWARE_DIR}/src
    ${CMAKE_BINARY_DIR}/include
)

target_compile_options(app PRIVATE -Werror)

# Gcode test vectors (tests/gcode/<flavor>/, shared with the web parser),
# bundled into one embedded file with "=== <name>.<ext>" separators.
set(GCODE_LATHECODE_DIR ${REPO_DIR}/tests/gcode/lathecode)
file(GLOB GCODE_LATHECODE_GCODE_FILES CONFIGURE_DEPENDS ${GCODE_LATHECODE_DIR}/*.gcode)
set_property(DIRECTORY APPEND PROPERTY CMAKE_CONFIGURE_DEPENDS ${GCODE_LATHECODE_GCODE_FILES})

# Written as a C byte list (not via file(READ) text) so CRLF survives.
set(GCODE_LATHECODE_HEX "")
foreach(gcodeFile ${GCODE_LATHECODE_GCODE_FILES})
    get_filename_component(vectorName ${gcodeFile} NAME_WE)
    set(stepsFile ${GCODE_LATHECODE_DIR}/${vectorName}.steps)
    set_property(DIRECTORY APPEND PROPERTY CMAKE_CONFIGURE_DEPENDS ${stepsFile})
    foreach(ext gcode steps)
        string(HEX "=== ${vectorName}.${ext}\n" headerHex)
        file(READ ${GCODE_LATHECODE_DIR}/${vectorName}.${ext} bodyHex HEX)
        string(HEX "\n" newlineHex)
        string(APPEND GCODE_LATHECODE_HEX "${headerHex}${bodyHex}${newlineHex}")
    endforeach()
endforeach()
string(REGEX REPLACE "([0-9a-f][0-9a-f])" "0x\\1," GCODE_LATHECODE_BYTES "${GCODE_LATHECODE_HEX}")
file(WRITE ${CMAKE_BINARY_DIR}/include/gcode_lathecode_vectors.inc "${GCODE_LATHECODE_BYTES}\n")
```

## prj.conf
```kconfig
CONFIG_ZTEST=y
CONFIG_CPP=y
CONFIG_STD_CPP17=y
CONFIG_REQUIRES_FULL_LIBCPP=y
CONFIG_JSON_LIBRARY=y
CONFIG_JSON_LIBRARY_FP_SUPPORT=y
```

## src/test_display_text.cpp
```c
/*
 * This file is part of the ScrewSync project.
 * Copyright (c) 2026 Donatas Olsevičius
 *
 * This program is free software: you can redistribute it and/or modify
 * it under the terms of the GNU Affero General Public License as published by
 * the Free Software Foundation, either version 3 of the License, or
 * (at your option) any later version.
 *
 * This program is distributed in the hope that it will be useful, but
 * WITHOUT ANY WARRANTY; without even the implied warranty of
 * MERCHANTABILITY or FITNESS FOR A PARTICULAR PURPOSE. See the GNU
 * Affero General Public License for more details.
 *
 * You should have received a copy of the GNU Affero General Public License
 * along with this program. If not, see <http://www.gnu.org/licenses/>.
 */
#include <zephyr/ztest.h>
#include <string.h>
#include "DisplayText.hpp"

using namespace Display::Detail;
using ModeCells::Cell;
using ModeCells::Kind;

namespace
{
    Cell cell(Kind kind, const char *when = nullptr)
    {
        return {kind, "p", "P", nullptr, nullptr, nullptr, nullptr, when};
    }

    const char *length(double du, bool inch)
    {
        static char out[24];
        formatLength(du, inch, out, sizeof(out));
        return out;
    }

    const char *trimmed(const char *text)
    {
        static char out[24];
        strcpy(out, text);
        trimZeros(out);
        return out;
    }

    const char *value(Kind kind, const char *raw, bool inch = false)
    {
        static char out[32];
        formatCellValue(cell(kind), raw, inch, out, sizeof(out));
        return out;
    }
}

ZTEST_SUITE(display_text, NULL, NULL, NULL, NULL, NULL);

ZTEST(display_text, test_format_length)
{
    zassert_str_equal(length(12340, false), "1.234");
    zassert_str_equal(length(-5000, false), "-0.500");
    zassert_str_equal(length(1234560, false), "123.456");
    zassert_str_equal(length(254000, true), "1.0000");
    zassert_str_equal(length(-127000, true), "-0.5000");
    zassert_str_equal(length(0, false), "0.000");
}

ZTEST(display_text, test_format_length_has_no_negative_zero)
{
    zassert_str_equal(length(-1, false), "0.000");
    zassert_str_equal(length(-1, true), "0.0000");
}

ZTEST(display_text, test_unit_suffix)
{
    zassert_str_equal(unitSuffix(false), "mm");
    zassert_str_equal(unitSuffix(true), "in");
}

ZTEST(display_text, test_trim_zeros)
{
    zassert_str_equal(trimmed("1.500"), "1.5");
    zassert_str_equal(trimmed("2.000"), "2");
    zassert_str_equal(trimmed("0.000"), "0");
    zassert_str_equal(trimmed("100"), "100");
    zassert_str_equal(trimmed("10.01"), "10.01");
}

ZTEST(display_text, test_param_value)
{
    const char *params = "pitch=15000 axis=z dir=- stop-after=0";
    char v[16];
    zassert_true(paramValue(params, "pitch", v, sizeof(v)));
    zassert_str_equal(v, "15000");
    zassert_true(paramValue(params, "axis", v, sizeof(v)));
    zassert_str_equal(v, "z");
    zassert_true(paramValue(params, "stop-after", v, sizeof(v)));
    zassert_str_equal(v, "0");
    zassert_false(paramValue(params, "pit", v, sizeof(v)));
    zassert_false(paramValue(params, "after", v, sizeof(v)));
    zassert_false(paramValue("", "pitch", v, sizeof(v)));
}

ZTEST(display_text, test_cell_shown)
{
    zassert_true(cellShown(cell(Kind::Angle), "axis=x"));
    zassert_true(cellShown(cell(Kind::Angle, "axis=z"), "pitch=1 axis=z"));
    zassert_false(cellShown(cell(Kind::Angle, "axis=z"), "pitch=1 axis=x"));
    zassert_false(cellShown(cell(Kind::Angle, "axis=z"), "pitch=1"));
}

ZTEST(display_text, test_cell_value_lengths)
{
    zassert_str_equal(value(Kind::Length, "15000"), "1.5 mm");
    zassert_str_equal(value(Kind::Pitch, "12500"), "1.25 mm");
    zassert_str_equal(value(Kind::Feed, "1000"), "0.1 mm/rev");
    zassert_str_equal(value(Kind::Speed, "3000000"), "300 mm/min");
    zassert_str_equal(value(Kind::Feed, "254000", true), "1 in/rev");
}

ZTEST(display_text, test_cell_value_reports_zero)
{
    char out[32];
    zassert_false(formatCellValue(cell(Kind::Length), "0", false, out, sizeof(out)));
    zassert_str_equal(out, "0 mm");
    zassert_true(formatCellValue(cell(Kind::Length), "1", false, out, sizeof(out)));
    zassert_true(formatCellValue(cell(Kind::Count), "0", false, out, sizeof(out)));
    zassert_true(formatCellValue(cell(Kind::Angle), "0", false, out, sizeof(out)));
}

ZTEST(display_text, test_cell_value_count_and_angle)
{
    zassert_str_equal(value(Kind::Count, "5"), "5");
    zassert_str_equal(value(Kind::Angle, "1.79"), "1.79°");
    zassert_str_equal(value(Kind::Angle, "30"), "30°");
    zassert_str_equal(value(Kind::Angle, "0"), "0°");
    zassert_str_equal(value(Kind::Angle, "-0.001"), "0°");
    zassert_str_equal(value(Kind::Angle, "-1.5"), "-1.5°");
}

ZTEST(display_text, test_group_label)
{
    char out[16];
    groupLabel("bsp", out, sizeof(out));
    zassert_str_equal(out, "BSP");
    groupLabel("unef", out, sizeof(out));
    zassert_str_equal(out, "UNEF");
    groupLabel("metric", out, sizeof(out));
    zassert_str_equal(out, "Metric");
    groupLabel("metric", out, 4);
    zassert_str_equal(out, "Met");
    groupLabel("", out, sizeof(out));
    zassert_str_equal(out, "");
}

ZTEST(display_text, test_designation_label)
{
    char out[32];
    designationLabel("M10x1.25", out, sizeof(out));
    zassert_str_equal(out, "M10×1.25");
    designationLabel("1/2NPT", out, sizeof(out));
    zassert_str_equal(out, "1/2NPT");
    designationLabel("x1", out, sizeof(out));
    zassert_str_equal(out, "x1");
    designationLabel("M10xL", out, sizeof(out));
    zassert_str_equal(out, "M10xL");
    designationLabel("M10x1.25", out, 6);
    zassert_str_equal(out, "M10");
}

ZTEST(display_text, test_list_items)
{
    const char *list = "metric,unc,bsp";
    char item[16];
    zassert_true(nextItem(list, item, sizeof(item)));
    zassert_str_equal(item, "metric");
    zassert_true(nextItem(list, item, sizeof(item)));
    zassert_str_equal(item, "unc");
    zassert_true(nextItem(list, item, sizeof(item)));
    zassert_str_equal(item, "bsp");
    zassert_false(nextItem(list, item, sizeof(item)));
    zassert_str_equal(item, "");
}

ZTEST(display_text, test_has_item)
{
    zassert_true(hasItem("metric,unc,bsp", "metric"));
    zassert_true(hasItem("metric,unc,bsp", "bsp"));
    zassert_false(hasItem("metric,unc,bsp", "un"));
    zassert_false(hasItem("metric,unc,bsp", "uncx"));
    zassert_false(hasItem("", "metric"));
}
```

## src/test_encoder_filter.cpp
```c
/*
 * This file is part of the ScrewSync project.
 * Copyright (c) 2026 Donatas Olsevičius
 *
 * This program is free software: you can redistribute it and/or modify
 * it under the terms of the GNU Affero General Public License as published by
 * the Free Software Foundation, either version 3 of the License, or
 * (at your option) any later version.
 *
 * This program is distributed in the hope that it will be useful, but
 * WITHOUT ANY WARRANTY; without even the implied warranty of
 * MERCHANTABILITY or FITNESS FOR A PARTICULAR PURPOSE. See the GNU
 * Affero General Public License for more details.
 *
 * You should have received a copy of the GNU Affero General Public License
 * along with this program. If not, see <http://www.gnu.org/licenses/>.
 */
#include <zephyr/ztest.h>
#include "EncoderFilter.hpp"

using Encoder::Direction;
using Encoder::Filter;

namespace
{
    constexpr int32_t BACKLASH = 3;
    constexpr int64_t POLL_MS = 2;
}

ZTEST_SUITE(encoder_filter, NULL, NULL, NULL, NULL, NULL);

ZTEST(encoder_filter, test_first_reading_seeds)
{
    Filter f;
    zassert_equal(f.update(1234, 0, false, BACKLASH), 1234);
    zassert_equal(f.direction(0), Direction::Stopped);
}

ZTEST(encoder_filter, test_slop_inside_the_deadband_is_absorbed)
{
    Filter f;
    f.update(100, 0, false, BACKLASH);
    zassert_equal(f.update(103, POLL_MS, false, BACKLASH), 100);
    zassert_equal(f.update(97, 2 * POLL_MS, false, BACKLASH), 100);
    zassert_equal(f.direction(2 * POLL_MS), Direction::Stopped);
}

ZTEST(encoder_filter, test_follows_past_the_deadband)
{
    Filter f;
    f.update(100, 0, false, BACKLASH);
    zassert_equal(f.update(104, POLL_MS, false, BACKLASH), 101);
    zassert_equal(f.direction(POLL_MS), Direction::Forward);
    zassert_equal(f.update(110, 2 * POLL_MS, false, BACKLASH), 107);
    // A reversal takes two deadbands of raw travel to show.
    zassert_equal(f.update(104, 3 * POLL_MS, false, BACKLASH), 107);
    zassert_equal(f.direction(3 * POLL_MS), Direction::Forward);
    zassert_equal(f.update(103, 4 * POLL_MS, false, BACKLASH), 106);
    zassert_equal(f.direction(4 * POLL_MS), Direction::Reverse);
}

ZTEST(encoder_filter, test_zero_backlash_follows_raw)
{
    Filter f;
    f.update(0, 0, false, 0);
    zassert_equal(f.update(1, POLL_MS, false, 0), 1);
    zassert_equal(f.update(-5, 2 * POLL_MS, false, 0), -5);
    zassert_equal(f.direction(2 * POLL_MS), Direction::Reverse);
}

ZTEST(encoder_filter, test_direction_goes_stale)
{
    Filter f;
    f.update(0, 0, false, 0);
    f.update(10, POLL_MS, false, 0);
    zassert_equal(f.direction(POLL_MS + Filter::STALE_MS), Direction::Forward);
    zassert_equal(f.direction(POLL_MS + Filter::STALE_MS + 1), Direction::Stopped);
}

ZTEST(encoder_filter, test_move_after_a_poll_pause_has_no_direction)
{
    Filter f;
    f.update(0, 0, false, 0);
    int64_t later = Filter::STALE_MS + 1;
    zassert_equal(f.update(500, later, false, 0), 500);
    zassert_equal(f.direction(later), Direction::Stopped);
    f.update(501, later + POLL_MS, false, 0);
    zassert_equal(f.direction(later + POLL_MS), Direction::Forward);
}

ZTEST(encoder_filter, test_changed_settings_restart_the_filter)
{
    Filter f;
    f.update(100, 0, false, BACKLASH);
    f.update(110, POLL_MS, false, BACKLASH);
    zassert_equal(f.update(110, 2 * POLL_MS, false, BACKLASH + 1), 110);
    zassert_equal(f.update(-110, 3 * POLL_MS, true, BACKLASH + 1), -110);
    zassert_equal(f.direction(3 * POLL_MS), Direction::Forward, "a restart is not a move");
}
```

## src/test_gcode.cpp
```c
/*
 * This file is part of the ScrewSync project.
 * Copyright (c) 2026 Donatas Olsevičius
 *
 * This program is free software: you can redistribute it and/or modify
 * it under the terms of the GNU Affero General Public License as published by
 * the Free Software Foundation, either version 3 of the License, or
 * (at your option) any later version.
 *
 * This program is distributed in the hope that it will be useful, but
 * WITHOUT ANY WARRANTY; without even the implied warranty of
 * MERCHANTABILITY or FITNESS FOR A PARTICULAR PURPOSE. See the GNU
 * Affero General Public License for more details.
 *
 * You should have received a copy of the GNU Affero General Public License
 * along with this program. If not, see <http://www.gnu.org/licenses/>.
 */
#include <zephyr/ztest.h>
#include <string.h>
#include <stdlib.h>
#include "GcodeCore.hpp"
#include "GcodeFlavors.hpp"
#include "GcodeLathecode.hpp"

using namespace Gcode;

namespace
{
    const unsigned char VECTORS_BLOB[] = {
#include "gcode_lathecode_vectors.inc"
    };
    constexpr size_t VECTORS_BLOB_LEN = sizeof(VECTORS_BLOB);
    constexpr size_t MAX_BLOB_CHARS = 32768;
    constexpr size_t MAX_LINES = 1024;
    constexpr size_t MAX_BLOCKS = 128;
    constexpr size_t MAX_VECTORS = 64;
    constexpr size_t MAX_STEPS_PER_VECTOR = 64;

    // Splits buf in place on sep, writing up to maxToks non-empty token
    // pointers into toks. Avoids strtok so it nests safely (line-splitting
    // calls this, then word-splitting calls it again on each line).
    // Unlike splitInPlace, keeps empty lines so line numbers stay right.
    size_t splitLines(char *buf, char **lines, size_t maxLines)
    {
        size_t count = 0;
        char *p = buf;
        while (*p) {
            zassert_true(count < maxLines, "too many lines");
            lines[count++] = p;
            while (*p && *p != '\n') {
                p++;
            }
            if (*p) {
                *p++ = '\0';
            }
        }
        return count;
    }

    size_t splitInPlace(char *buf, char sep, char **toks, size_t maxToks)
    {
        size_t count = 0;
        char *p = buf;
        while (*p) {
            while (*p == sep) {
                *p++ = '\0';
            }
            if (!*p) {
                break;
            }
            zassert_true(count < maxToks, "too many tokens");
            toks[count++] = p;
            while (*p && *p != sep) {
                p++;
            }
        }
        return count;
    }

    struct Block
    {
        char name[64];
        bool isSteps;
        size_t firstLine;
        size_t lineCount;
    };

    bool stripSuffix(char *name, const char *suffix)
    {
        size_t nameLen = strlen(name);
        size_t suffixLen = strlen(suffix);
        if (nameLen < suffixLen) {
            return false;
        }
        if (strcmp(name + (nameLen - suffixLen), suffix) != 0) {
            return false;
        }
        name[nameLen - suffixLen] = '\0';
        return true;
    }

    size_t findBlocks(char **lines, size_t lineCount, Block *blocks, size_t maxBlocks)
    {
        size_t blockCount = 0;
        size_t i = 0;
        while (i < lineCount) {
            zassert_true(strncmp(lines[i], "=== ", 4) == 0, "expected a vector header line: %s", lines[i]);
            zassert_true(blockCount < maxBlocks, "too many vector blocks");

            Block &b = blocks[blockCount];
            char header[64];
            strncpy(header, lines[i] + 4, sizeof(header) - 1);
            header[sizeof(header) - 1] = '\0';

            if (stripSuffix(header, ".steps")) {
                b.isSteps = true;
            } else {
                zassert_true(stripSuffix(header, ".gcode"), "bad vector header: %s", lines[i]);
                b.isSteps = false;
            }
            strncpy(b.name, header, sizeof(b.name) - 1);
            b.name[sizeof(b.name) - 1] = '\0';

            i++;
            b.firstLine = i;
            while (i < lineCount && strncmp(lines[i], "=== ", 4) != 0) {
                i++;
            }
            b.lineCount = i - b.firstLine;
            blockCount++;
        }
        return blockCount;
    }

    struct Vector
    {
        const char *name;
        char **gcodeLines;
        size_t gcodeLineCount;
        char **stepsLines;
        size_t stepsLineCount;
    };

    size_t pairVectors(const Block *blocks, size_t blockCount, char **lines, Vector *vectors, size_t maxVectors)
    {
        size_t vectorCount = 0;
        for (size_t i = 0; i < blockCount; i++) {
            if (blocks[i].isSteps) {
                continue;
            }
            zassert_true(vectorCount < maxVectors, "too many vectors");
            Vector &v = vectors[vectorCount];
            v.name = blocks[i].name;
            v.gcodeLines = &lines[blocks[i].firstLine];
            v.gcodeLineCount = blocks[i].lineCount;
            v.stepsLines = nullptr;
            v.stepsLineCount = 0;

            for (size_t j = 0; j < blockCount; j++) {
                if (blocks[j].isSteps && strcmp(blocks[j].name, blocks[i].name) == 0) {
                    v.stepsLines = &lines[blocks[j].firstLine];
                    v.stepsLineCount = blocks[j].lineCount;
                    break;
                }
            }
            zassert_not_null(v.stepsLines, "%s: .gcode vector has no matching .steps", v.name);
            vectorCount++;
        }
        return vectorCount;
    }

    class CollectSink : public StepSink
    {
    public:
        size_t count = 0;
        Step steps[MAX_STEPS_PER_VECTOR];

        void emit(const Step &step) override
        {
            zassert_true(count < MAX_STEPS_PER_VECTOR, "too many steps collected");
            steps[count++] = step;
        }
    };

    const char *kindName(StepKind kind)
    {
        switch (kind) {
        case StepKind::Rapid:
            return "rapid";
        case StepKind::Feed:
            return "feed";
        case StepKind::Thread:
            return "thread";
        case StepKind::Pause:
            return "pause";
        case StepKind::OptionalPause:
            return "optional-pause";
        case StepKind::End:
            return "end";
        }
        return "?";
    }

    bool isMotionKind(StepKind kind)
    {
        return kind == StepKind::Rapid || kind == StepKind::Feed || kind == StepKind::Thread;
    }

    bool hasFeedField(StepKind kind)
    {
        return kind == StepKind::Feed || kind == StepKind::Thread;
    }

    struct Expectation
    {
        uint32_t line;
        bool isError;
        StepKind kind;
        int32_t zDu;
        int32_t xDu;
        int32_t feed;
    };

    bool parseKind(const char *text, StepKind &kind)
    {
        if (strcmp(text, "rapid") == 0) {
            kind = StepKind::Rapid;
            return true;
        }
        if (strcmp(text, "feed") == 0) {
            kind = StepKind::Feed;
            return true;
        }
        if (strcmp(text, "thread") == 0) {
            kind = StepKind::Thread;
            return true;
        }
        if (strcmp(text, "pause") == 0) {
            kind = StepKind::Pause;
            return true;
        }
        if (strcmp(text, "optional-pause") == 0) {
            kind = StepKind::OptionalPause;
            return true;
        }
        if (strcmp(text, "end") == 0) {
            kind = StepKind::End;
            return true;
        }
        return false;
    }

    size_t parseSteps(char **lines, size_t lineCount, Expectation *out, size_t outCap)
    {
        size_t count = 0;
        for (size_t li = 0; li < lineCount; li++) {
            char *line = lines[li];
            while (*line == ' ' || *line == '\t') {
                line++;
            }
            if (*line == '\0' || *line == '#') {
                continue;
            }

            char *toks[8];
            size_t tokCount = splitInPlace(line, ' ', toks, 8);
            zassert_true(tokCount >= 2, "malformed .steps line: %s", line);

            zassert_true(count < outCap, "too many expectations");
            Expectation &e = out[count];
            e.isError = false;
            e.zDu = 0;
            e.xDu = 0;
            e.feed = 0;
            e.line = (uint32_t)strtoul(toks[0], nullptr, 10);

            if (strcmp(toks[1], "error") == 0) {
                e.isError = true;
            } else {
                zassert_true(parseKind(toks[1], e.kind), "unknown kind in .steps line: %s", line);
                bool haveZ = false, haveX = false, haveF = false;
                for (size_t ti = 2; ti < tokCount; ti++) {
                    if (strncmp(toks[ti], "z=", 2) == 0) {
                        e.zDu = atoi(toks[ti] + 2);
                        haveZ = true;
                    } else if (strncmp(toks[ti], "x=", 2) == 0) {
                        e.xDu = atoi(toks[ti] + 2);
                        haveX = true;
                    } else if (strncmp(toks[ti], "f=", 2) == 0) {
                        e.feed = atoi(toks[ti] + 2);
                        haveF = true;
                    }
                }
                zassert_true(!isMotionKind(e.kind) || (haveZ && haveX), "missing z/x in .steps line");
                zassert_true(!hasFeedField(e.kind) || haveF, "missing f in .steps line");
            }
            count++;
        }
        return count;
    }

    void runVector(const Vector &v)
    {
        Expectation expectations[MAX_STEPS_PER_VECTOR];
        size_t expectCount = parseSteps(v.stepsLines, v.stepsLineCount, expectations, MAX_STEPS_PER_VECTOR);

        Lathecode flavor;
        flavor.begin(0, 0);
        CollectSink sink;

        const char *errorMsg = nullptr;
        uint32_t errorLine = 0;
        for (size_t i = 0; i < v.gcodeLineCount && !errorMsg; i++) {
            uint32_t lineNo = (uint32_t)(i + 1);
            const char *err = interpretLine(flavor, v.gcodeLines[i], lineNo, sink);
            if (err) {
                errorMsg = err;
                errorLine = lineNo;
            }
        }

        size_t stepIndex = 0;
        for (size_t i = 0; i < expectCount; i++) {
            const Expectation &e = expectations[i];
            if (e.isError) {
                zassert_not_null(errorMsg, "%s: expected error at line %u, got none", v.name, e.line);
                zassert_equal(errorLine, e.line, "%s: error at wrong line", v.name);
                zassert_equal(stepIndex, sink.count, "%s: steps emitted after/around the error", v.name);
                return;
            }
            zassert_true(stepIndex < sink.count, "%s: missing step at line %u", v.name, e.line);
            const Step &s = sink.steps[stepIndex];
            zassert_equal(s.line, e.line, "%s: step %u wrong line", v.name, (unsigned)stepIndex);
            zassert_equal((int)s.kind, (int)e.kind, "%s: step %u wrong kind (got %s)", v.name, (unsigned)stepIndex, kindName(s.kind));
            if (isMotionKind(e.kind)) {
                zassert_equal(s.zDu, e.zDu, "%s: step %u wrong zDu", v.name, (unsigned)stepIndex);
                zassert_equal(s.xDu, e.xDu, "%s: step %u wrong xDu", v.name, (unsigned)stepIndex);
            }
            if (hasFeedField(e.kind)) {
                zassert_equal(s.feed, e.feed, "%s: step %u wrong feed", v.name, (unsigned)stepIndex);
            }
            stepIndex++;
        }
        zassert_is_null(errorMsg, "%s: unexpected error: %s", v.name, errorMsg ? errorMsg : "");
        zassert_equal(stepIndex, sink.count, "%s: extra unexpected steps emitted", v.name);
    }
}

ZTEST_SUITE(gcode, NULL, NULL, NULL, NULL, NULL);

ZTEST(gcode, test_vectors)
{
    static char blob[MAX_BLOB_CHARS];
    zassert_true(VECTORS_BLOB_LEN < MAX_BLOB_CHARS, "vector bundle too large");
    memcpy(blob, VECTORS_BLOB, VECTORS_BLOB_LEN);
    blob[VECTORS_BLOB_LEN] = '\0';

    static char *lines[MAX_LINES];
    size_t lineCount = splitLines(blob, lines, MAX_LINES);

    static Block blocks[MAX_BLOCKS];
    size_t blockCount = findBlocks(lines, lineCount, blocks, MAX_BLOCKS);

    static Vector vectors[MAX_VECTORS];
    size_t vectorCount = pairVectors(blocks, blockCount, lines, vectors, MAX_VECTORS);
    zassert_true(vectorCount > 0, "no gcode test vectors found");

    for (size_t i = 0; i < vectorCount; i++) {
        runVector(vectors[i]);
    }
}

ZTEST(gcode, test_tokenize_strips_comments)
{
    Words words;
    zassert_is_null(tokenize("G1 X10 ; trailing comment", words));
    zassert_equal(words.count, 2);
    zassert_is_null(tokenize("G1 (inline) X10", words));
    zassert_equal(words.count, 2);
    zassert_equal(words.words[1].letter, 'X');
    zassert_is_null(tokenize("(only a comment)", words));
    zassert_equal(words.count, 0);
    zassert_is_null(tokenize("%", words));
    zassert_equal(words.count, 0);
}

ZTEST(gcode, test_tokenize_crlf)
{
    Words words;
    zassert_is_null(tokenize("G1 X10\r", words));
    zassert_equal(words.count, 2);
    zassert_equal(words.words[0].letter, 'G');
    zassert_equal(words.words[1].letter, 'X');
    zassert_within(words.words[1].value, 10.0, 1e-9);
}

ZTEST(gcode, test_tokenize_no_space_words)
{
    Words words;
    zassert_is_null(tokenize("G1X10Z-2.5F100", words));
    zassert_equal(words.count, 4);
    zassert_equal(words.words[0].letter, 'G');
    zassert_within(words.words[0].value, 1.0, 1e-9);
    zassert_equal(words.words[1].letter, 'X');
    zassert_within(words.words[1].value, 10.0, 1e-9);
    zassert_equal(words.words[2].letter, 'Z');
    zassert_within(words.words[2].value, -2.5, 1e-9);
    zassert_equal(words.words[3].letter, 'F');
    zassert_within(words.words[3].value, 100.0, 1e-9);
}

ZTEST(gcode, test_tokenize_n_word_ignored)
{
    Words words;
    zassert_is_null(tokenize("N100 G1 X10", words));
    zassert_equal(words.count, 2);
    zassert_equal(words.words[0].letter, 'G');
}

ZTEST(gcode, test_tokenize_malformed_words)
{
    Words words;
    zassert_not_null(tokenize("G1 X", words));
    zassert_not_null(tokenize("10 X5", words));
    zassert_not_null(tokenize("G1 #5", words));
}

ZTEST(gcode, test_tokenize_number_forms)
{
    Words words;

    zassert_is_null(tokenize("X1e3", words));
    zassert_equal(words.count, 2);
    zassert_equal(words.words[1].letter, 'E');
    zassert_is_null(tokenize("g0x10", words));
    zassert_equal(words.count, 2);
    zassert_equal(words.words[1].letter, 'X');
    zassert_not_null(tokenize("Xnan", words));
    zassert_not_null(tokenize("X-", words));

    zassert_is_null(tokenize("X.5", words));
    zassert_equal(words.count, 1);
    zassert_within(words.words[0].value, 0.5, 1e-9);

    zassert_is_null(tokenize("X-.5", words));
    zassert_equal(words.count, 1);
    zassert_within(words.words[0].value, -0.5, 1e-9);
}

ZTEST(gcode, test_flavor_registry)
{
    zassert_true(Gcode::count() > 0);
    for (size_t i = 0; i < Gcode::count(); i++) {
        Flavor *flavor = Gcode::at(i);
        zassert_not_null(flavor);
        zassert_equal(Gcode::find(flavor->id()), flavor, "flavor ids are not unique");
    }
    zassert_not_null(Gcode::find("lathecode"));
    zassert_is_null(Gcode::find("nope"));
    zassert_is_null(Gcode::find(""));
}
```

## src/test_gcode_meta.cpp
```c
/*
 * This file is part of the ScrewSync project.
 * Copyright (c) 2026 Donatas Olsevičius
 *
 * This program is free software: you can redistribute it and/or modify
 * it under the terms of the GNU Affero General Public License as published by
 * the Free Software Foundation, either version 3 of the License, or
 * (at your option) any later version.
 *
 * This program is distributed in the hope that it will be useful, but
 * WITHOUT ANY WARRANTY; without even the implied warranty of
 * MERCHANTABILITY or FITNESS FOR A PARTICULAR PURPOSE. See the GNU
 * Affero General Public License for more details.
 *
 * You should have received a copy of the GNU Affero General Public License
 * along with this program. If not, see <http://www.gnu.org/licenses/>.
 */
#include <zephyr/ztest.h>
#include <string.h>
#include "GcodeMeta.hpp"
#include "GcodeLathecode.hpp"

using namespace GcodeMeta;

ZTEST_SUITE(gcode_meta, NULL, NULL, NULL, NULL, NULL);

ZTEST(gcode_meta, test_valid_name)
{
    zassert_true(validName("part1", 5));
    zassert_true(validName("caf\xc3\xa9", 5)); // UTF-8 "café"
    zassert_false(validName("", 0));
    zassert_false(validName(nullptr, 0));
    zassert_false(validName("x\ty", 3)); // tab is a control char
    zassert_false(validName("x\x7fy", 3)); // DEL
    char tooLong[NAME_MAX_LEN + 2];
    memset(tooLong, 'a', sizeof(tooLong));
    zassert_true(validName(tooLong, NAME_MAX_LEN));
    zassert_false(validName(tooLong, NAME_MAX_LEN + 1));
}

ZTEST(gcode_meta, test_header_round_trip)
{
    char buf[128];
    int n = encodeHeader("lathecode", "part1", buf, sizeof(buf));
    zassert_true(n > 0);
    zassert_mem_equal(buf, "lathecode\tpart1\n", n);

    Header h;
    zassert_true(decodeHeader(buf, n, h));
    zassert_equal(h.flavorLen, 9);
    zassert_mem_equal(h.flavor, "lathecode", h.flavorLen);
    zassert_equal(h.nameLen, 5);
    zassert_mem_equal(h.name, "part1", h.nameLen);
    zassert_equal(h.bodyOffset, (size_t)n);
}

ZTEST(gcode_meta, test_encode_header_too_small)
{
    char buf[4];
    zassert_equal(encodeHeader("lathecode", "part1", buf, sizeof(buf)), -1);
}

ZTEST(gcode_meta, test_decode_header_with_body)
{
    const char *text = "lathecode\tmy part\nG0 X0 Z0\nG1 X1\n";
    Header h;
    zassert_true(decodeHeader(text, strlen(text), h));
    zassert_equal(h.flavorLen, 9);
    zassert_equal(h.nameLen, 7);
    zassert_mem_equal(h.name, "my part", h.nameLen);
    zassert_str_equal(text + h.bodyOffset, "G0 X0 Z0\nG1 X1\n");
}

ZTEST(gcode_meta, test_decode_header_malformed)
{
    Header h;
    zassert_false(decodeHeader("no newline here", 16, h)); // no '\n'
    zassert_false(decodeHeader("noheadertab\n", 12, h)); // no tab
    zassert_false(decodeHeader("\tname\n", 6, h)); // empty flavor
    zassert_false(decodeHeader("lathecode\t\n", 11, h)); // empty name
}

ZTEST(gcode_meta, test_validate_program_ok)
{
    Gcode::Lathecode flavor;
    const char *text = "G0 Z-1 X0\nG1 X1 Z-2 F100\n";
    ValidateResult r = validateProgram(text, strlen(text), flavor);
    zassert_true(r.ok);
    zassert_is_null(r.error);
    zassert_equal(r.steps, 2);
}

ZTEST(gcode_meta, test_validate_program_axes_mismatch)
{
    Gcode::Lathecode flavor;
    const char *text = "; Axes expected: Z+ points left, X+ points up\nG1 X1 Z-2 F100\n";
    ValidateResult r = validateProgram(text, strlen(text), flavor);
    zassert_false(r.ok);
    zassert_not_null(strstr(r.error, "axes mismatch"));
}

ZTEST(gcode_meta, test_validate_program_empty)
{
    Gcode::Lathecode flavor;
    ValidateResult r = validateProgram("", 0, flavor);
    zassert_false(r.ok);
    zassert_str_equal(r.error, "empty program");
}

ZTEST(gcode_meta, test_validate_program_embedded_nul)
{
    Gcode::Lathecode flavor;
    char text[] = {'G', '0', ' ', 'X', '0', '\0', '\n'};
    ValidateResult r = validateProgram(text, sizeof(text), flavor);
    zassert_false(r.ok);
    zassert_str_equal(r.error, "embedded NUL byte");
}

ZTEST(gcode_meta, test_validate_program_line_too_long)
{
    Gcode::Lathecode flavor;
    char text[Gcode::MAX_LINE_LEN + 32];
    size_t n = 0;
    text[n++] = 'G';
    text[n++] = '0';
    text[n++] = ' ';
    text[n++] = 'X';
    while (n < sizeof(text) - 2) {
        text[n++] = '0';
    }
    text[n++] = '\n';
    ValidateResult r = validateProgram(text, n, flavor);
    zassert_false(r.ok);
    zassert_str_equal(r.error, "line too long");
    zassert_equal(r.line, 1);
}

ZTEST(gcode_meta, test_validate_program_syntax_error_reports_line)
{
    Gcode::Lathecode flavor;
    const char *text = "G0 X0 Z0\nG97\nG1 X1\n";
    ValidateResult r = validateProgram(text, strlen(text), flavor);
    zassert_false(r.ok);
    zassert_not_null(r.error);
    zassert_equal(r.line, 2);
}

ZTEST(gcode_meta, test_validate_program_no_motion_steps)
{
    Gcode::Lathecode flavor;
    const char *text = "G20\nG90\n(just comments)\n";
    ValidateResult r = validateProgram(text, strlen(text), flavor);
    zassert_false(r.ok);
    zassert_str_equal(r.error, "no motion steps");
}

ZTEST(gcode_meta, test_axes_mismatch_no_header)
{
    const char *text = "G0 X0 Z0\n";
    zassert_false(axesMismatch(text, strlen(text)));
}

ZTEST(gcode_meta, test_axes_mismatch_matches)
{
    const char *text = "; Axes expected: Z+ points right, X+ points down\nG0 X0 Z0\n";
    zassert_false(axesMismatch(text, strlen(text)));
}

ZTEST(gcode_meta, test_axes_mismatch_x_wrong)
{
    const char *text = "; Axes expected: Z+ points right, X+ points up\nG0 X0 Z0\n";
    zassert_true(axesMismatch(text, strlen(text)));
}

ZTEST(gcode_meta, test_axes_mismatch_z_wrong)
{
    const char *text = "; Axes expected: Z+ points left, X+ points down\nG0 X0 Z0\n";
    zassert_true(axesMismatch(text, strlen(text)));
}

ZTEST(gcode_meta, test_axes_mismatch_both_wrong)
{
    const char *text = "; Axes expected: Z+ points left, X+ points up\nG0 X0 Z0\n";
    zassert_true(axesMismatch(text, strlen(text)));
}

ZTEST(gcode_meta, test_axes_mismatch_case_insensitive)
{
    const char *text = "; AXES EXPECTED: z+ POINTS RIGHT, x+ POINTS DOWN\nG0 X0 Z0\n";
    zassert_false(axesMismatch(text, strlen(text)));
}

ZTEST(gcode_meta, test_valid_id)
{
    zassert_true(GcodeMeta::validId("0000abcd", 8));
    zassert_true(GcodeMeta::validId("12345678", 8));
    zassert_false(GcodeMeta::validId("0000ABCD", 8));
    zassert_false(GcodeMeta::validId("0000abc", 8));
    zassert_false(GcodeMeta::validId("0000abcde", 8));
    zassert_false(GcodeMeta::validId("0000abcg", 8));
    zassert_false(GcodeMeta::validId("../../ab", 8));
    zassert_false(GcodeMeta::validId("", 8));
}

ZTEST(gcode_meta, test_program_file_id)
{
    uint32_t id = 0;
    zassert_true(GcodeMeta::programFileId("0000001f.gc", 8, id));
    zassert_equal(id, 0x1f);
    zassert_true(GcodeMeta::programFileId("ffffffff.gc", 8, id));
    zassert_equal(id, 0xffffffff);
    zassert_false(GcodeMeta::programFileId("0000001f.tmp", 8, id));
    zassert_false(GcodeMeta::programFileId("0000001f.gcx", 8, id));
    zassert_false(GcodeMeta::programFileId("0000001f", 8, id));
    zassert_false(GcodeMeta::programFileId("000001f.gc", 8, id));
    zassert_false(GcodeMeta::programFileId("0000001g.gc", 8, id));
}
```

## src/test_jog_button.cpp
```c
/*
 * This file is part of the ScrewSync project.
 * Copyright (c) 2026 Donatas Olsevičius
 *
 * This program is free software: you can redistribute it and/or modify
 * it under the terms of the GNU Affero General Public License as published by
 * the Free Software Foundation, either version 3 of the License, or
 * (at your option) any later version.
 *
 * This program is distributed in the hope that it will be useful, but
 * WITHOUT ANY WARRANTY; without even the implied warranty of
 * MERCHANTABILITY or FITNESS FOR A PARTICULAR PURPOSE. See the GNU
 * Affero General Public License for more details.
 *
 * You should have received a copy of the GNU Affero General Public License
 * along with this program. If not, see <http://www.gnu.org/licenses/>.
 */
#include <zephyr/ztest.h>
#include "JogButton.hpp"

using Event = JogButton::Event;

ZTEST_SUITE(jog_button, nullptr, nullptr, nullptr, nullptr, nullptr);

ZTEST(jog_button, test_short_press_taps)
{
    JogButton b = {};
    zassert_equal(b.update(true, 0, 300, 100), Event::None);
    zassert_equal(b.update(true, 200, 300, 100), Event::None);
    zassert_equal(b.update(false, 250, 300, 100), Event::Tap);
    zassert_equal(b.update(false, 300, 300, 100), Event::None);
}

ZTEST(jog_button, test_long_press_holds_then_releases)
{
    JogButton b = {};
    b.update(true, 0, 300, 100);
    zassert_equal(b.update(true, 300, 300, 100), Event::Hold);
    zassert_equal(b.update(true, 350, 300, 100), Event::None);
    zassert_equal(b.update(true, 400, 300, 100), Event::Hold);
    zassert_equal(b.update(false, 420, 300, 100), Event::Release);
}

ZTEST(jog_button, test_blocked_until_release)
{
    JogButton b = {false, false, true, 0, 0};
    zassert_equal(b.update(true, 0, 300, 100), Event::None);
    zassert_equal(b.update(true, 500, 300, 100), Event::None);
    zassert_equal(b.update(false, 600, 300, 100), Event::None);
    zassert_equal(b.update(true, 700, 300, 100), Event::None);
    zassert_equal(b.update(false, 750, 300, 100), Event::Tap);
}
```

## src/test_jog_ratio.cpp
```c
/*
 * This file is part of the ScrewSync project.
 * Copyright (c) 2026 Donatas Olsevičius
 *
 * This program is free software: you can redistribute it and/or modify
 * it under the terms of the GNU Affero General Public License as published by
 * the Free Software Foundation, either version 3 of the License, or
 * (at your option) any later version.
 *
 * This program is distributed in the hope that it will be useful, but
 * WITHOUT ANY WARRANTY; without even the implied warranty of
 * MERCHANTABILITY or FITNESS FOR A PARTICULAR PURPOSE. See the GNU
 * Affero General Public License for more details.
 *
 * You should have received a copy of the GNU Affero General Public License
 * along with this program. If not, see <http://www.gnu.org/licenses/>.
 */
#include <zephyr/ztest.h>
#include "JogRatio.hpp"

using Jog::jogSteps;

// Settings.hpp defaults: 800 motor steps/rev, 600 handwheel pulses/rev.

ZTEST_SUITE(jog_ratio, NULL, NULL, NULL, NULL, NULL);

ZTEST(jog_ratio, test_no_count_change_no_steps)
{
    double remainder = 0;
    zassert_equal(jogSteps(0, 800, 600.0f, 1.0f, remainder), 0);
    zassert_equal(remainder, 0.0);
}

ZTEST(jog_ratio, test_one_handwheel_turn_moves_one_motor_revolution)
{
    double remainder = 0;
    zassert_equal(jogSteps(600, 800, 600.0f, 1.0f, remainder), 800);
}

ZTEST(jog_ratio, test_negative_turn_moves_back)
{
    double remainder = 0;
    zassert_equal(jogSteps(-600, 800, 600.0f, 1.0f, remainder), -800);
}

ZTEST(jog_ratio, test_coarse_multiplier_scales_up)
{
    double remainder = 0;
    zassert_equal(jogSteps(600, 800, 600.0f, 10.0f, remainder), 8000);
}

ZTEST(jog_ratio, test_fine_multiplier_scales_down)
{
    double remainder = 0;
    zassert_equal(jogSteps(600, 800, 600.0f, 0.1f, remainder), 80);
}

ZTEST(jog_ratio, test_single_counts_at_fine_resolution_add_up)
{
    double remainder = 0;
    int64_t total = 0;
    for (int i = 0; i < 600; i++) {
        total += jogSteps(1, 800, 600.0f, 0.1f, remainder);
    }
    zassert_within(total, 80, 1, "got %lld", (long long)total);
}

ZTEST(jog_ratio, test_there_and_back_returns_to_start)
{
    double remainder = 0;
    int64_t total = 0;
    for (int i = 0; i < 250; i++) {
        total += jogSteps(1, 800, 600.0f, 1.0f, remainder);
    }
    for (int i = 0; i < 250; i++) {
        total += jogSteps(-1, 800, 600.0f, 1.0f, remainder);
    }
    zassert_equal(total, 0, "got %lld", (long long)total);
}
```

## src/test_jog_step.cpp
```c
/*
 * This file is part of the ScrewSync project.
 * Copyright (c) 2026 Donatas Olsevičius
 *
 * This program is free software: you can redistribute it and/or modify
 * it under the terms of the GNU Affero General Public License as published by
 * the Free Software Foundation, either version 3 of the License, or
 * (at your option) any later version.
 *
 * This program is distributed in the hope that it will be useful, but
 * WITHOUT ANY WARRANTY; without even the implied warranty of
 * MERCHANTABILITY or FITNESS FOR A PARTICULAR PURPOSE. See the GNU
 * Affero General Public License for more details.
 *
 * You should have received a copy of the GNU Affero General Public License
 * along with this program. If not, see <http://www.gnu.org/licenses/>.
 */
#include <zephyr/ztest.h>
#include "JogStep.hpp"

using namespace Jog;

ZTEST_SUITE(jog_step, nullptr, nullptr, nullptr, nullptr, nullptr);

ZTEST(jog_step, test_cycle_presets_then_custom)
{
    const int32_t *p = stepPresets(false);
    zassert_equal(nextStep(p[0], 123, false), p[1]);
    zassert_equal(nextStep(p[1], 123, false), p[2]);
    zassert_equal(nextStep(p[2], 123, false), 123);
    zassert_equal(nextStep(123, 123, false), p[0]);
}

ZTEST(jog_step, test_cycle_skips_missing_custom)
{
    const int32_t *p = stepPresets(true);
    zassert_equal(nextStep(p[2], 0, true), p[0]);
    zassert_equal(nextStep(p[2], p[1], true), p[0]);
}

ZTEST(jog_step, test_cycle_from_other_units)
{
    zassert_equal(nextStep(stepPresets(false)[1], 0, true), stepPresets(true)[0]);
}

ZTEST(jog_step, test_dial_mm)
{
    zassert_equal(dialStep(1000, 1, 1, false), 1010);
    zassert_equal(dialStep(1000, -2, 10, false), 800);
    zassert_equal(dialStep(10, -5, 1, false), 10);
    zassert_equal(dialStep(MAX_STEP_DU, 3, 100, false), MAX_STEP_DU);
}

ZTEST(jog_step, test_dial_inch)
{
    zassert_equal(dialStep(254, 1, 1, true), 257);
    zassert_equal(dialStep(254, 1, 10, true), 279);
    zassert_equal(dialStep(3, -1, 1, true), 3);
}

ZTEST(jog_step, test_multiplier_by_speed)
{
    zassert_equal(dialMultiplier(500), 1);
    zassert_equal(dialMultiplier(50), 10);
    zassert_equal(dialMultiplier(10), 100);
    zassert_true(dialMultiplier(0) >= dialMultiplier(10));
}
```

## src/test_json_span.cpp
```c
/*
 * This file is part of the ScrewSync project.
 * Copyright (c) 2026 Donatas Olsevičius
 *
 * This program is free software: you can redistribute it and/or modify
 * it under the terms of the GNU Affero General Public License as published by
 * the Free Software Foundation, either version 3 of the License, or
 * (at your option) any later version.
 *
 * This program is distributed in the hope that it will be useful, but
 * WITHOUT ANY WARRANTY; without even the implied warranty of
 * MERCHANTABILITY or FITNESS FOR A PARTICULAR PURPOSE. See the GNU
 * Affero General Public License for more details.
 *
 * You should have received a copy of the GNU Affero General Public License
 * along with this program. If not, see <http://www.gnu.org/licenses/>.
 */
#include <zephyr/ztest.h>
#include <zephyr/data/json.h>
#include <zephyr/sys/util.h>
#include <string.h>
#include "JsonSpan.hpp"
#include "Settings.hpp"

namespace
{
    char g_buf[4096];

    bool find(const char *json, const char *key, const char *expected)
    {
        strcpy(g_buf, json);
        char *start = nullptr;
        size_t len = 0;
        if (!JsonSpan::findObject(g_buf, strlen(g_buf), key, start, len)) {
            return expected == nullptr;
        }
        return expected && len == strlen(expected) && !memcmp(start, expected, len);
    }

    struct SettingsDoc
    {
        Settings::Conf settings;
    };

    const struct json_obj_descr SETTINGS_DOC_DESCR[] = {
        JSON_OBJ_DESCR_OBJECT(SettingsDoc, settings, Settings::CONF_JSON_DESCR),
    };

    SettingsDoc g_doc;
    Settings::Conf g_parsed;
    char g_reencoded[4096];
}

ZTEST(json_span, test_finds_top_level_object)
{
    zassert_true(find(R"({"a":1,"settings":{"x":[1,{"y":2}]},"b":2})", "settings", R"({"x":[1,{"y":2}]})"));
    zassert_true(find(R"({ "settings" : {} })", "settings", "{}"));
}

ZTEST(json_span, test_ignores_nested_and_string_matches)
{
    zassert_true(find(R"({"run":{"settings":{"a":1}}})", "settings", nullptr));
    zassert_true(find(R"({"mode":"settings","x":{}})", "settings", nullptr));
    zassert_true(find(R"({"s":"\"settings\":{","settings":{"q":"}"}})", "settings", R"({"q":"}"})"));
}

ZTEST(json_span, test_rejects_missing_or_broken)
{
    zassert_true(find(R"({"settings":1})", "settings", nullptr));
    zassert_true(find(R"({"settings":{"a":1)", "settings", nullptr));
    zassert_true(find(R"({"settings":{"a":"1)", "settings", nullptr));
}

// Every settings field, so the field mask passes bit 31.
ZTEST(json_span, test_full_settings_round_trip)
{
    g_doc.settings = Settings::Conf{};
    g_doc.settings.x.invertDirection = true;
    g_doc.settings.x.invertHandwheel = true;
    zassert_ok(json_obj_encode_buf(SETTINGS_DOC_DESCR, ARRAY_SIZE(SETTINGS_DOC_DESCR), &g_doc, g_buf, sizeof(g_buf)));
    char *start = nullptr;
    size_t len = 0;
    zassert_true(JsonSpan::findObject(g_buf, strlen(g_buf), "settings", start, len));
    int64_t mask = json_obj_parse(start, len, Settings::CONF_JSON_DESCR, Settings::CONF_JSON_FIELDS, &g_parsed);
    zassert_equal(mask, (int64_t)BIT64_MASK(Settings::CONF_JSON_FIELDS));

    g_doc.settings = g_parsed;
    zassert_ok(json_obj_encode_buf(SETTINGS_DOC_DESCR, ARRAY_SIZE(SETTINGS_DOC_DESCR), &g_doc, g_reencoded,
                                   sizeof(g_reencoded)));
    zassert_true(strstr(g_reencoded, "\"invertDirectionX\":true") != nullptr);
    zassert_true(strstr(g_reencoded, "\"invertHandwheelX\":true") != nullptr);
}

ZTEST_SUITE(json_span, NULL, NULL, NULL, NULL, NULL);
```
